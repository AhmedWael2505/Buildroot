## package/hello/Config.in
```kconfig
config BR2_PACKAGE_HELLO
    bool "Enable Hello World kernel module"
    depends on BR2_LINUX_KERNEL
    help
      Enable support for the Hello World kernel module.
```

## package/rtl8192cu/Config.in
```kconfig
config BR2_PACKAGE_RTL8192CU
	bool "rtl8192cu"
	depends on !BR2_s390x
	depends on BR2_LINUX_KERNEL
	help
	  A standalone driver for the RTL8192CU USB Wi-Fi adapter.

	  Make sure your target kernel has the CONFIG_WIRELESS_EXT
	  config option enabled.

	  https://https://github.com/lwfinger/rtl8192cu

comment "rtl8192cu needs a Linux kernel to be built"
	depends on !BR2_s390x
	depends on !BR2_LINUX_KERNEL
```
